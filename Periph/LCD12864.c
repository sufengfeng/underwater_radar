/******************** (C) COPYRIGHT 2014 DY ************************************
 * 文件名  ：lcd12864.c
 * 描述    ：LCD液晶显示         
 * 实验平台：高频开发板
 * 库版本  ：
 *
 * 作者    ：liqhuang
 *公司网站 ：http://www.diy715.com
 * 版本    ：V1.0
**********************************************************************************/


#include "LCD12864.h"
	 

 /****************************数字点阵码表*********************************/
/****************************数字点阵码表*********************************/
//点阵格式：阴码
//取模方式：列行式
//取模走向：逆向（低位在前）
//C51格式

const unsigned char LcdFont[][16]={

{0x00,0x07,0x08,0x10,0x10,0x08,0x07,0x00,0x00,0xF0,0x08,0x04,0x04,0x08,0xF0,0x00},/*"0",0*/

{0x00,0x08,0x08,0x1F,0x00,0x00,0x00,0x00,0x00,0x04,0x04,0xFC,0x04,0x04,0x00,0x00},/*"1",1*/
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{0x00,0x00,0x00,0x00,0x00,0x00,0x00,0x00,0x00,0x0C,0x0C,0x00,0x00,0x00,0x00,0x00},/*".",10*/

};

/****************************汉字点阵码表*********************************/
/****************************汉字点阵码表*********************************/
//点阵格式：阴码
//取模方式：列行式
//取模走向：顺向（高位在前）
//C51格式
const unsigned char Font[][32]  = {

{0x00,0x7C,0x44,0x47,0x44,0x7C,0x00,0x7F,0x44,0x44,0x44,0x44,0x44,0x47,0x40,0x00,
0x02,0xFE,0x04,0xFC,0x88,0x88,0x00,0xFE,0x42,0x42,0x42,0x42,0x42,0xC2,0x02,0x00},/*"距",0*/

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{0x04,0x04,0x44,0x24,0x1C,0x07,0x04,0xFF,0x06,0x05,0x0C,0x14,0x64,0x04,0x04,0x00,
0x02,0x04,0x08,0x30,0xC0,0x00,0x00,0xFF,0x00,0x80,0x60,0x10,0x18,0x0C,0x08,0x00},/*" 米",4*/
};



/*********************************************************
 - 功能描述：初始化LCD
 - 隶属模块：公开函数模块
 - 函数属性：
 - 参数说明：          
 - 返回说明：
 - 注：      
 *********************************************************/
void ResetLcd(void)
{
	ClrRES;
	Delay_RUs(100);
	
	SetRES;   //2010.6.29增加以上三句，解决一体液晶屏经常花屏的问题
	Delay_RUs(100);

	Write_COM(Disp_Off);               //Display OFF
	Write_COM(SetBias9);             // 设置BIAS为1/9
	Write_COM(ADC_Normal);      //从左至右输入
	Write_COM(OUTNormal);      //com1 --> com64
	Write_COM(V5Ratio);           // Select internal resistor ratio(Rb/Ra)mode

	Write_COM(V5OutVol);         // Set the v5 output voltage      
	Write_COM(SetBright);         //调节液晶屏的亮度
	Write_COM(POWERSet);      //voltage follower ON   regulator ON   booster ON
	Write_COM(DispNormal);     // 从左至右显示
	Write_COM(AllNormal);        //Entire Display Disable

	Write_COM(Disp_On);         //Display ON
	ClrScreen();             
	Write_COM(SetStartLine);      //Set Display Start Line = com0
	Write_COM(SetPage);          //Set Page Address = 0
	Write_COM(SetColMsb);       //Set Column Address = 0,set 4 higher bits
	Write_COM(SetColLsb);      //set 4 lower bits of column of display data RAM in register
}

/*********************************************************
 - 功能描述：传递数据到LCD  (串行)
 - 隶属模块：公开函数模块
 - 函数属性：
 - 参数说明：          
 - 返回说明：
 - 注：      
 *********************************************************/
void Write_SPI(uint8_t data)
{
	uint8_t  Count;
	
	for (Count=0; Count<8; Count++)
	{
		if (data & 0x80)
		{
			Set_SI; 
		}
		else
		{
			Clr_SI;
		}
		
		data <<= 1;                
		Set_CLK;
		Delay_RUs(1);
		Clr_CLK;
		Delay_RUs(1);
	}	
}

/*********************************************************
 - 功能描述：写命令到LCD  (串行)
 - 隶属模块：公开函数模块
 - 函数属性：
 - 参数说明：          
 - 返回说明：
 - 注：      
 *********************************************************/
void Write_COM(uint8_t cmdcode)
{
	Clr_CLK;
	Delay_RUs(1);
	ClrA0;
	Delay_RUs(1);
	ClrCS1;
	Write_SPI(cmdcode) ; 
	SetCS1;  
}

/*********************************************************
 - 功能描述：写数据到LCD  (串行)
 - 隶属模块：公开函数模块
 - 函数属性：
 - 参数说明：          
 - 返回说明：
 - 注：      
 *********************************************************/
void WriteData(uint8_t dispdata)
{      
	Clr_CLK;
	Delay_RUs(1);    
	SetA0;
	Delay_RUs(1);   
	ClrCS1; 
	Write_SPI(dispdata) ; 
	SetCS1;
}

/*********************************************************
 - 功能描述：清除LCD全屏
 - 隶属模块：公开函数模块
 - 函数属性：
 - 参数说明：          
 - 返回说明：
 - 注：      
 *********************************************************/
void ClrScreen(void)
{
	uint8_t i, j;
	Write_COM(SetStartLine);      //Set Display Start Line = com0
	
	for (i=0; i<8; i++)
	{ 
		Write_COM(SetPage+i);  //Set Page Address
		
		for (j=0; j<128; j++)
		{
			Write_COM(SetColLsb|(j&0x0f));
			Write_COM(SetColMsb|((j&0xf0)>>4));
			WriteData(0x00);
		}
	}
}

/*********************************************************
 - 功能描述：在任意位置显示任意大小点阵
 - 隶属模块：公开函数模块
 - 函数属性：
 - 参数说明：     startCol	起始最左列			
	              startL	起始最上端行				   *	   *
	                             
 *********************************************************/
 
void printNumbers(uint8_t startL,uint8_t startCol,int16_t code)//输入阿拉伯数字 8*16 字模
{
	
	    uint8_t col;

		Write_COM(0x10+(startCol>>4));
		Write_COM(startCol&0x0f);
		Write_COM(0xB0+startL);
		for(col = 0; col < 8; col++)
		{ 
			WriteData(LcdFont[code][col]);
		}
		Write_COM(0x10+(startCol>>4));
		Write_COM(startCol&0x0f);
		Write_COM(0xB0+startL-1);
		for(col = 0; col < 8; col++)
		{
			WriteData(LcdFont[code][col+8]);
		}
}
void printFront(uint8_t startL,uint8_t startCol,int16_t uChar) //输入字 16*16 字模 
{ 
	   
	    uint8_t col;

		Write_COM(0x10+(startCol>>4));
		Write_COM(startCol&0x0f);
		Write_COM(0xB0+startL);
		for(col = 0; col < 16; col++)
		{ 
			WriteData(Font[uChar][col]);
		}
		Write_COM(0x10+(startCol>>4));
		Write_COM(startCol&0x0f);
		Write_COM(0xB0+startL-1);
		for(col = 0; col < 16; col++)
		{
			WriteData(Font[uChar][col+16]);
		}
}








